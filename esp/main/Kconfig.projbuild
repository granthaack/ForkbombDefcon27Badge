## esp/main/Kconfig.projbuild
```kconfig
menu "Badge Configuration"

config RPI_WIFI_SSID
    string "WiFi SSID"
	default "HailStallman"
	help
		SSID of the RPi AP

config RPI_WIFI_PASSWORD
    string "WiFi Password"
	default "fossforever"
	help
		Password for the RPi AP

config RPI_HOST_IP
  string "Host (RPi) IP"
  default "192.168.0.1"
  help
    The IP of the RPi TCP Host

config TCP_PORT
    int "Port"
    range 0 65535
    default 3333
    help
        TCP port used for communication

endmenu
```
